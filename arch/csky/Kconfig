## arch/csky/Kconfig
```kconfig
#
# Copyright (C) 2017-2020 Alibaba Group Holding Limited
#
# SPDX-License-Identifier: GPL-2.0+
#

menu "CSKY architecture"
    depends on CSKY

config SYS_ARCH
    default "csky"

config CPU_C807_810
    bool

config CPU_C860
    bool

config SYS_CPU
    default "c807_810" if CPU_C807_810
    default "c860" if CPU_C860

choice
    prompt "ASIC select"
    optional

config IS_ASIC
    bool "support ASIC"

endchoice

choice
    prompt "trust cpu select"
    optional

config TRUST_CPU
    bool "use trust cpu"

endchoice

choice
    prompt "Target select"
    optional

config TARGET_ICE_C860
    bool "Support T-HEAD ICE C860 Board"
    select CPU_C860
    select SUPPORT_SPL

config TARGET_ICE_C810
    bool "Support T-HEAD ICE C810 Board"
    select CPU_C807_810
    select SUPPORT_SPL

config TARGET_TIANHUO_C860
    bool "Support T-HEAD TIANHUO C860 Board"
    select CPU_C860
    select SUPPORT_SPL

config TARGET_TIANHUO_C810
    bool "Support T-HEAD TIANHUO C810 Board"
    select CPU_C807_810
    select SUPPORT_SPL

config TARGET_ANOLE_C860
    bool "Support T-HEAD Anole C860 Board"
    select CPU_C860
    select SUPPORT_SPL

config TARGET_ANOLE_C810
    bool "Support T-HEAD Anole C810 Board"
    select CPU_C807_810
    select SUPPORT_SPL

endchoice

source "board/thead/ice-c860/Kconfig"
source "board/thead/ice-c810/Kconfig"
source "board/thead/tianhuo-c860/Kconfig"
source "board/thead/tianhuo-c810/Kconfig"
source "board/thead/anole-c860/Kconfig"
source "board/thead/anole-c810/Kconfig"

source "arch/csky/cpu/c807_810/Kconfig"
source "arch/csky/cpu/c860/Kconfig"

endmenu
```

## arch/csky/cpu/c860/Kconfig
```kconfig
#
# Copyright (C) 2017-2020 Alibaba Group Holding Limited
#
# SPDX-License-Identifier: GPL-2.0+
#

config C860_CSKY
    bool
    imply CPU
    imply CPU_CSKY
    imply CMD_CPU
```

## arch/riscv/cpu/c9xx/Kconfig
```kconfig
#
# Copyright (C) 2017-2020 Alibaba Group Holding Limited
#
# SPDX-License-Identifier: GPL-2.0+
#

config RISCV_THEAD
	bool
	select ARCH_EARLY_INIT_R
	imply CPU
	imply CPU_RISCV
	imply RISCV_TIMER
	imply RISCV_RDTIME
	imply CMD_CPU
	imply THEAD_IPI
	imply SPL_CPU_SUPPORT
	imply SPL_OPENSBI
	imply SPL_LOAD_FIT

config DDR_BOARD_CONFIG
	bool "DDR info via Board config"
	help
		Collect DDR info via Board config.
```

## board/thead/anole-c810/Kconfig
```kconfig
#
# Copyright (C) 2017-2020 Alibaba Group Holding Limited
#
# SPDX-License-Identifier: GPL-2.0+
#

if TARGET_ANOLE_C810

config SYS_VENDOR
    default "thead"

config SYS_BOARD
    default "anole-c810"

config SYS_CONFIG_NAME
    default "anole-c810"

config SYS_TEXT_BASE
    default 0x57800000

config SPL_TEXT_BASE
    default 0xfe400000

config BOARD_SPECIFIC_OPTIONS # dummy
    def_bool y
    imply CMD_FAT
    imply CMD_FS_GENERIC
    imply CMD_NET
    imply CMD_PING
    imply MII
    imply NET_RANDOM_ETHADDR
    imply PHY_LIB
    imply PHY_MSCC
    imply SPI
    imply MMC
    imply CMD_MMC

endif
```

## board/thead/anole-c860/Kconfig
```kconfig
#
# Copyright (C) 2017-2020 Alibaba Group Holding Limited
#
# SPDX-License-Identifier: GPL-2.0+
#

if TARGET_ANOLE_C860

config SYS_VENDOR
	default "thead"

config SYS_BOARD
	default "anole-c860"

config SYS_CONFIG_NAME
	string "Board configuration name"
	default "anole-c860"
	help
	This option contains information about board configuration name.
	Based on this option include/configs/<CONFIG_SYS_CONFIG_NAME>.h header
	will be used for board configuration.

config SYS_TEXT_BASE
	default 0x17800000

config SPL_TEXT_BASE
	default 0xfe410000

config BOARD_SPECIFIC_OPTIONS
	def_bool y
	select C860_CSKY
	imply CMD_DHCP
	imply CMD_EXT2
	imply CMD_EXT4
	imply CMD_FAT
	imply CMD_FS_GENERIC
	imply CMD_NET
	imply CMD_PING
	imply CMD_TFTPPUT
	imply CMD_TFTPSRV
	imply CMD_BOOT_SLAVE
	imply NET_RANDOM_ETHADDR
	imply NETDEVICES
	imply ETH_DESIGNWARE
	imply MMC
	imply CMD_MMC
	imply DOS_PARTITION
	imply EFI_PARTITION
	imply IP_DYN
	imply ISO_PARTITION
	imply MACB
	imply MII
	imply PHY_LIB
	imply PHY_MSCC
	imply SPI

config SYS_ANOLE_DDR4
	bool "DDR4 support for Anole Board"
	default n
	help
	  This enables DDR4 sdram code support for the platforms based
	  on Anole EVB.

endif
```

## board/thead/common/Kconfig
```kconfig
#
# Copyright (C) 2017-2020 Alibaba Group Holding Limited
#
# SPDX-License-Identifier: GPL-2.0+
#

config BOARD_CONSOLE_SUPPORT
    bool

config BOARD_MMC_SUPPORT
    bool

config BOARD_PRINTF_SUPPORT
    bool

config BOARD_SPIFLASH_SUPPORT
    bool
```

## board/thead/ice-c860/Kconfig
```kconfig
#
# Copyright (C) 2017-2020 Alibaba Group Holding Limited
#
# SPDX-License-Identifier: GPL-2.0+
#

if TARGET_ICE_C860

config SYS_VENDOR
    default "thead"

config SYS_BOARD
    default "ice-c860"

config SYS_CONFIG_NAME
    default "ice-c860"

config SYS_TEXT_BASE
    default 0x17800000

config SPL_TEXT_BASE
    default 0xfe400000

config BOARD_SPECIFIC_OPTIONS
    def_bool y
    select C860_CSKY
    imply CMD_DHCP
    imply CMD_EXT2
    imply CMD_EXT4
    imply CMD_FAT
    imply CMD_FS_GENERIC
    imply CMD_NET
    imply CMD_PING
    imply CMD_TFTPPUT
    imply CMD_TFTPSRV
    imply CMD_BOOT_SLAVE
    imply NET_RANDOM_ETHADDR
    imply NETDEVICES
    imply ETH_DESIGNWARE
    imply MMC
    imply CMD_MMC
    imply DOS_PARTITION
    imply EFI_PARTITION
    imply IP_DYN
    imply ISO_PARTITION
    imply MACB
    imply MII
    imply PHY_LIB
    imply PHY_MSCC
    imply SPI

endif
```

## board/thead/ice-c910/Kconfig
```kconfig
#
# Copyright (C) 2017-2020 Alibaba Group Holding Limited
#
# SPDX-License-Identifier: GPL-2.0+
#

if TARGET_ICE_C910

config SYS_CPU
    default "c9xx"

config SYS_VENDOR
    default "thead"

config SYS_BOARD
    default "ice-c910"

config SYS_CONFIG_NAME
    default "ice-c910"

config SYS_TEXT_BASE
    default 0xc0000000 if RISCV_MMODE
    default 0x00200000 if RISCV_SMODE

config BOARD_SPECIFIC_OPTIONS # dummy
    def_bool y
    select RISCV_THEAD
    imply CMD_FAT
    imply CMD_NET
    imply CMD_PING
    imply CMD_BOOT_SLAVE
    imply MII
    imply NET_RANDOM_ETHADDR
    imply PHY_LIB
    imply PHY_MSCC
    imply SPI
    imply MMC
    imply MMC_SPI
    imply MMC_BROKEN_CD
    imply CMD_MMC
    imply SMP

endif
```

## board/thead/light-fpga-fm-c910/Kconfig
```kconfig
#
# Copyright (C) 2017-2020 Alibaba Group Holding Limited
#
# SPDX-License-Identifier: GPL-2.0+
#

if TARGET_LIGHT_FPGA_FM_C910

config SYS_CPU
    default "c9xx"

config SYS_VENDOR
    default "thead"

config SYS_BOARD
    default "light-fpga-fm-c910"

config SYS_CONFIG_NAME
    default "light-fpga-fm-c910"

config SYS_TEXT_BASE
	default 0xc0000000 if RISCV_MMODE
    default 0x00200000 if RISCV_SMODE

config SPL_TEXT_BASE
    hex
    default 0xffe0000000

config SPL_MAX_SIZE
    hex
    default 0x2f000

config BOARD_SPECIFIC_OPTIONS
    def_bool y
    select RISCV_THEAD
    imply CMD_NET
    imply CMD_PING
    imply CMD_MEMINFO
    imply MII
    imply NET_RANDOM_ETHADDR
    imply PHY_LIB
    imply PHY_MSCC
    imply MMC
    imply MMC_SPI
    imply MMC_BROKEN_CD
    imply CMD_MMC

endif
```

## board/thead/tianhuo-c810/Kconfig
```kconfig
#
# Copyright (C) 2017-2020 Alibaba Group Holding Limited
#
# SPDX-License-Identifier: GPL-2.0+
#

if TARGET_TIANHUO_C810

config SYS_VENDOR
    default "thead"

config SYS_BOARD
    default "tianhuo-c810"

config SYS_CONFIG_NAME
    default "tianhuo-c810"

config SYS_TEXT_BASE
    default 0x97800000

config SPL_TEXT_BASE
    default 0xff800000

config BOARD_SPECIFIC_OPTIONS # dummy
    def_bool y
    imply CMD_FAT
    imply CMD_FS_GENERIC
    imply CMD_NET
    imply CMD_PING
    imply MII
    imply NET_RANDOM_ETHADDR
    imply PHY_LIB
    imply PHY_MSCC
    imply SPI
    imply MMC
    imply CMD_MMC

endif
```

## board/thead/tianhuo-c860/Kconfig
```kconfig
#
# Copyright (C) 2017-2020 Alibaba Group Holding Limited
#
# SPDX-License-Identifier: GPL-2.0+
#

if TARGET_TIANHUO_C860

config SYS_VENDOR
    default "thead"

config SYS_BOARD
    default "tianhuo-c860"

config SYS_CONFIG_NAME
    default "tianhuo-c860"

config SYS_TEXT_BASE
    default 0x17800000

config SPL_TEXT_BASE
    default 0xff800000

config BOARD_SPECIFIC_OPTIONS # dummy
    def_bool y
    select C860_CSKY
    imply CMD_FAT
    imply CMD_FS_GENERIC
    imply CMD_NET
    imply CMD_PING
    imply MII
    imply CMD_BOOT_SLAVE
    imply NET_RANDOM_ETHADDR
    imply NETDEVICES
    imply ETH_DESIGNWARE
    imply MMC
    imply CMD_MMC
    imply PHY_LIB
    imply PHY_MSCC
    imply SPI

endif
```

## configs/anole_dh_evb_c860_defconfig
```kconfig
CONFIG_CSKY=y
CONFIG_NR_DRAM_BANKS=1
CONFIG_TARGET_ANOLE_C860=y
CONFIG_SYS_CONFIG_NAME="anole-dh-c860"
CONFIG_ANOLE_BOARD_DH=y
CONFIG_SYS_PROMPT="C860 # "
CONFIG_IS_ASIC=y
CONFIG_DISTRO_DEFAULTS=y
CONFIG_FIT=y
CONFIG_DEFAULT_DEVICE_TREE="anole-mii-c860"
CONFIG_DISPLAY_CPUINFO=y
CONFIG_DISPLAY_BOARDINFO=y
CONFIG_SYS_NS16550=y
CONFIG_OF_PRIOR_STAGE=y
CONFIG_BLK=y
# CONFIG_CMD_FLASH is not set
CONFIG_ENV_IS_IN_MMC=y
CONFIG_ENV_OFFSET=0x1fc000
CONFIG_ENV_SIZE=0x4000
CONFIG_BOARD_EARLY_INIT_R
CONFIG_BOARD_EARLY_INIT_F
CONFIG_OF_CONTROL=y
CONFIG_CLK=y
CONFIG_DM_MMC=y
CONFIG_MMC_DW=y
CONFIG_MMC_DW_SNPS=y
CONFIG_MMC_BROKEN_CD=y
CONFIG_DM_ETH=y
CONFIG_ETH_DESIGNWARE=y
# CONFIG_EFI_LOADER is not set
# CONFIG_SPL_SERIAL_SUPPORT is not set
# CONFIG_PARTITIONS is not set
# CONFIG_SPL_FRAMEWORK is not set
CONFIG_SPL=y
```

## configs/ice_c810_defconfig
```kconfig
CONFIG_CSKY=y
CONFIG_ENV_SIZE=0x20000
CONFIG_ENV_OFFSET=0x10000
CONFIG_NR_DRAM_BANKS=1
CONFIG_TARGET_ICE_C810=y
CONFIG_SYS_PROMPT="CK810 # "
CONFIG_DISTRO_DEFAULTS=y
CONFIG_FIT=y
CONFIG_DEFAULT_DEVICE_TREE="ice-c810"
# CONFIG_DISPLAY_CPUINFO is not set
CONFIG_DISPLAY_BOARDINFO=y
CONFIG_SYS_NS16550=y
CONFIG_OF_PRIOR_STAGE=y
# CONFIG_BLK is not set
# CONFIG_CMD_FLASH is not set
CONFIG_ENV_IS_NOWHERE=y
CONFIG_ENV_IS_IN_MMC=y
CONFIG_BOARD_EARLY_INIT_R
CONFIG_BOARD_EARLY_INIT_F
CONFIG_OF_CONTROL=y
CONFIG_CLK=y
CONFIG_DM_MMC=y
CONFIG_MMC_DW=y
CONFIG_MMC_DW_SNPS=y
CONFIG_DM_ETH=y
CONFIG_ETH_DESIGNWARE=y
# CONFIG_EFI_LOADER is not set
# CONFIG_SPL_SERIAL_SUPPORT is not set
# CONFIG_PARTITIONS is not set
# CONFIG_SPL_FRAMEWORK is not set
CONFIG_SPL=y
```

## configs/ice_evb_c910_defconfig
```kconfig
CONFIG_RISCV=y
CONFIG_SPL_MMC_SUPPORT=y
CONFIG_ENV_SIZE=0x20000
CONFIG_ENV_OFFSET=0xe0000
CONFIG_NR_DRAM_BANKS=1
CONFIG_SPL=y
CONFIG_TARGET_ICE_C910=y
CONFIG_ARCH_RV64I=y
CONFIG_DISTRO_DEFAULTS=y
CONFIG_BUILD_TARGET="u-boot-with-spl.bin"
CONFIG_DISPLAY_CPUINFO=y
CONFIG_DISPLAY_BOARDINFO=y
# CONFIG_SPL_LEGACY_IMAGE_SUPPORT is not set
CONFIG_SPL_RAM_SUPPORT=y
CONFIG_SPL_RAM_DEVICE=y
CONFIG_SYS_PROMPT="C910 # "
CONFIG_CMD_ERASEENV=y
CONFIG_CMD_GPT=y
# CONFIG_DOS_PARTITION is not set
# CONFIG_ISO_PARTITION is not set
CONFIG_PARTITION_TYPE_GUID=y
CONFIG_OF_EMBED=y
CONFIG_DEFAULT_DEVICE_TREE="ice-c910"
CONFIG_ENV_IS_IN_MMC=y
CONFIG_SYS_RELOC_GD_ENV_ADDR=y
CONFIG_SPL_CLK=y
CONFIG_UDP_FUNCTION_FASTBOOT=y
CONFIG_FASTBOOT_BUF_ADDR=0x10000000
CONFIG_FASTBOOT_FLASH=y
CONFIG_FASTBOOT_FLASH_MMC_DEV=0
CONFIG_FASTBOOT_CMD_OEM_FORMAT=y
# CONFIG_MMC_SPI is not set
CONFIG_SUPPORT_EMMC_BOOT=y
CONFIG_MMC_DW=y
CONFIG_MMC_DW_SNPS=y
CONFIG_ETH_DESIGNWARE=y
CONFIG_SYS_NS16550=y
# CONFIG_SPL_USE_TINY_PRINTF is not set
# CONFIG_EFI_LOADER is not set
```

## drivers/video/light/Kconfig
```kconfig
#
# Light Video configuration
#

config VIDEO_VS_DPU
	bool "Verisilicon DPU(DC8200) video support"
	depends on DM_VIDEO && TARGET_LIGHT_C910
	help
	  Support for Verisilicon DPU controller on Light platform

config VIDEO_DW_DSI_LIGHT
	bool "Synopsys Designware MIPI DSI support on Light"
	depends on DM_VIDEO && TARGET_LIGHT_C910
	select VIDEO_DW_DSI_HOST
	help
	  support for Synopsys Designware MIPI DSI on Thead
	  Light platform.

config VIDEO_DW_DSI_HOST
	bool "Synopsys Designware MIPI DSI HOST support"
	depends on DM_VIDEO && TARGET_LIGHT_C910
	help
	  support for Synopsys Designware MIPI DSI HOST on
	  Thead Light platform.

config VIDEO_DW_DPHY
	bool "Synopsys Designware MIPI DSI DPHY support"
	depends on DM_VIDEO && TARGET_LIGHT_C910
	help
	  support for Synopsys Designware 2.5Gbps MIPI DPHY
	  on Thead Light platform.
```
